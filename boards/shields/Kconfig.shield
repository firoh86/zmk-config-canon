## config/boards/shields/rubiCanon/Kconfig.defconfig
```kconfig
if SHIELD_rubiCanon

# El nombre debe contener menos de 16 carácteres!
    config ZMK_KEYBOARD_NAME
    default "rubiCanon"

    config ZMK_USB
	default y

endif
```

## config/boards/shields/rubiCanon/Kconfig.shield
```kconfig
# Sin espacios tras la coma o en el nombre del teclado!


config SHIELD_rubiCanon
    def_bool $(shields_list_contains,rubiCanon)
```
